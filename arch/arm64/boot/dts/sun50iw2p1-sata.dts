/*
 * Allwinner Technology CO., Ltd. sun50iw2p1 perf1 sata board.
 *
 * perf1 sata board support.
 */

/dts-v1/;

/memreserve/ 0x78000000 0x08000000; /* ion carvout heap revserve  : [0x38000000~0x40000000], size = 128M  */

#include "sun50iw2p1.dtsi"

/{

	soc@01c00000 {

	};

	ion {
		carvout{
			type = <2>;
			name = "carvout";
			base = <0x78000000>;
			size = <0x08000000>;
		};
	};
};
