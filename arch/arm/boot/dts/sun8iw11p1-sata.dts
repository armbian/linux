/*
 * Allwinner Technology CO., Ltd. sun8iw11p1 perf1 sata board.
 *
 */

/dts-v1/;

/memreserve/ 0x78000000 0x08000000; /* ion carvout heap revserve  : [0x78000000~0x80000000], size = 128M  */

#include "sun8iw11p1.dtsi"

/{
	soc@01c00000 {
	};

	ion {
		carvout{
			type = <2>;
			name = "carvout";
			base = <0x78000000>;
			size = <0x08000000>;
		};
	};
};
